#include <FlagPCM.h>
#include <Stepper.h>
#include <Servo.h>

const unsigned char oof1[] PROGMEM = {
  129, 127, 127, 128, 127, 128, 127, 129, 127, 127, 129, 126,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 128
};
const unsigned char oof2[] PROGMEM = {
  129, 127, 126, 128, 127, 126, 127, 128, 129, 127, 127, 127,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 130
};
const unsigned char oof3[] PROGMEM = {
  126, 128, 128, 127, 129, 128, 127, 126, 126, 127, 127, 127,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 126
};
const unsigned char oof4[] PROGMEM = {
  129, 129, 129, 129, 129, 129, 129, 129, 129, 129, 129, 129,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 126
};
const unsigned char oof5[] PROGMEM = {
  125, 126, 127, 129, 131, 131, 129, 127, 127, 127, 127, 127,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 127
};
const unsigned char oof6[] PROGMEM = {
  129, 129, 129, 128, 128, 128, 127, 127, 127, 126, 125, 126,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 128
};

Servo moteur;

int angle = 0;

const int stepper1Pin = 8;

const int stepper2Pin = 9;

const int stepper3Pin = 10;

const int stepper4Pin = 6;

const int motorPin = 3;

const int echoPin = 7;

const int trigPin = 2;

const int harry = A5;

const int warningLed = 12;

const int buttonPin = 4;

bool stop = false;

int move = 0;

unsigned long prevTime;

bool firstLoop = true;

bool isPressed = false;

bool recommence = false;

bool wasClose = false;

bool stopButton = false;

const int stepsPerRevolution = 64;

Stepper small_stepper(stepsPerRevolution, stepper4Pin, stepper2Pin, stepper3Pin, stepper1Pin);

void setup() {

  Serial.begin(9600);
  pinMode(motorPin, OUTPUT);
  pinMode(buttonPin, INPUT_PULLUP);
  pinMode(harry, INPUT);
  pinMode(trigPin, OUTPUT);
  pinMode(echoPin, INPUT);
  pinMode(warningLed, OUTPUT);
  small_stepper.setSpeed(300);
  moteur.attach(motorPin);
}

int playRandomSound() {
  int index = random(1, 7);
  Serial.println(index);
  switch (index) {
    case 1 : playback(oof1, sizeof(oof1)); break;
    case 2 : playback(oof2, sizeof(oof2)); break;
    case 3 : playback(oof3, sizeof(oof3)); break;
    case 4 : playback(oof4, sizeof(oof4)); break;
    case 5 : playback(oof5, sizeof(oof5)); break;
    case 6 : playback(oof6, sizeof(oof6)); break;
  }
}

void loop() {

  int delai;
  float duration_us, distance_cm;

  if (firstLoop) {
    prevTime = millis();
    firstLoop = false;
  }
  if (analogRead(harry) >= 0 && analogRead(harry) < 200) {
    delai = 500;
  }

  else if (analogRead(harry) >= 200 && analogRead(harry) < 400) {
    delai = 600;
  }

  else if (analogRead(harry) >= 400 && analogRead(harry) < 600) {
    delai = 700;
  }

  else if (analogRead(harry) >= 600 && analogRead(harry) < 800) {
    delai = 800;
  }

  else if (analogRead(harry) >= 1000 && analogRead(harry) < 1023) {
    delai = 900;
  }

  unsigned long currTime = millis();


  if (((currTime - prevTime) >= (delai - 100 ) && (currTime - prevTime) <= (delai + 100) && stop == false) || recommence) {

    Serial.println("turning motor");
    Serial.println("___");
    Serial.println(delai);
    Serial.println(move);

    switch (move) {
      case (0):
        moteur.write(180);
        Serial.println("first move");
        move = 1;
        prevTime = currTime;
        recommence = false;
        break;

      case (1):
        moteur.write(0);
        playRandomSound();
        Serial.println("second move");
        move = 0;
        prevTime = currTime;
        recommence = false;
        break;
    }
  }
  if (digitalRead(buttonPin) == 0) {
    if (isPressed == false) {
      isPressed = !isPressed;
      if (stop == false) {
        stopButton = true;
        stop = !stop;
        //Serial.println("isPressed");
      }
      else {
        stopButton = false;
        stop = !stop;
        recommence = true;
        //Serial.println("recommence");
      }
    }
  }

  if (digitalRead(buttonPin) == 1) {
    if (isPressed == true) {
      //Serial.println("bouton relâché");
    }
    isPressed = false;

  }

  digitalWrite(trigPin, HIGH);
  delayMicroseconds(100);
  digitalWrite(trigPin, LOW);
  duration_us = pulseIn(echoPin, HIGH);
  distance_cm = 0.017 * duration_us;

  if (distance_cm <= 15 && !stopButton) {
    stop = true;
    wasClose = true;
    digitalWrite(warningLed, HIGH);
  }

  else if (wasClose && !stopButton) {

    wasClose = false;
    recommence = true;
    digitalWrite(warningLed, LOW);
    stop = false;

  }

  if (!stop) {
    small_stepper.step(10);
  }
}
